## sdkconfig.defaults
```kconfig
CONFIG_ESP_MAIN_TASK_STACK_SIZE=16384
CONFIG_PTHREAD_TASK_STACK_SIZE_DEFAULT=1024
CONFIG_ESP_SYSTEM_EVENT_TASK_STACK_SIZE=3072

CONFIG_PARTITION_TABLE_SINGLE_APP=n
CONFIG_PARTITION_TABLE_TYPE=PARTITION_TABLE_CUSTOM
CONFIG_PARTITION_TABLE_CUSTOM=y

CONFIG_PARTITION_TABLE_CUSTOM_FILENAME="../../../../../../partitions.csv"
CONFIG_ESPTOOLPY_FLASHSIZE_4MB=y

# Show debug logs
CONFIG_LOG_DEFAULT_LEVEL_DEBUG=y

# disable file cache to save heap
CONFIG_FATFS_PER_FILE_CACHE=n
```
